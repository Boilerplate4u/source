## target/linux/ar71xx/patches-4.9/failed/work/620-MIPS-ath79-add-support-for-QCA953x-SoC/Kconfig.0.patch
```kconfig
--- a/arch/mips/ath79/Kconfig
+++ b/arch/mips/ath79/Kconfig
@@ -116,6 +116,10 @@ config SOC_AR934X
 	select PCI_AR724X if PCI
 	def_bool n
 
+config SOC_QCA953X
+	select USB_ARCH_HAS_EHCI
+	def_bool n
+
 config SOC_QCA955X
 	select HW_HAS_PCI
 	select PCI_AR724X if PCI
```

## target/linux/ar71xx/patches-4.9/failed/work/620-MIPS-ath79-add-support-for-QCA953x-SoC/Kconfig.1.patch
```kconfig
--- a/arch/mips/ath79/Kconfig
+++ b/arch/mips/ath79/Kconfig
@@ -155,7 +159,7 @@ config ATH79_DEV_USB
 	def_bool n
 
 config ATH79_DEV_WMAC
-	depends on (SOC_AR913X || SOC_AR933X || SOC_AR934X || SOC_QCA955X)
+	depends on (SOC_AR913X || SOC_AR933X || SOC_AR934X || SOC_QCA953X || SOC_QCA955X)
 	def_bool n
 
 config ATH79_NVRAM
```
